/********************************************************************************
**                                                                             **
**                       GENERATED FILE BY CosmOS CustomBox                    **
**                                                                             **
*********************************************************************************
**                       DOXYGEN DOCUMENTATION INFORMATION                     **
*****************************************************************************//**
** @file STM32H755ZITX_FLASH.ld
*********************************************************************************
<!--                      Linker Local Group Definition                       -->
*********************************************************************************
** @brief CM7 arm gnu linker script
** @details lorem
*********************************************************************************
<!--                           Version Information                            -->
*********************************************************************************
** @version 2.0.0
** @date 2022-01-05
** @author Generated by CosmOS CustomBox
********************************************************************************/

ENTRY(Reset_Handler)

/* provided symbols for libraries */
_estack = 0x20020000;
end = 0x24008000;
_end = 0x24008000;

MEMORY
{
    LWIP_SRAM3_PATCH (xrw)      : ORIGIN = 0x30040000, LENGTH = 32K
    FLASH_LOCAL (rx)      : ORIGIN = 0x8000000, LENGTH = 0x80000
    FLASH_USER_CODE_CM7 (rx)      : ORIGIN = 0x8080000, LENGTH = 0x0800
    FLASH_USER_CODE_CM4 (rx)      : ORIGIN = 0x8180000, LENGTH = 0x0800
    UNMAPPED_DATA_PARTITION_IN_AXI_SRAM (xrw)     : ORIGIN = 0x24000000, LENGTH = 0x8000
    UNMAPPED_HEAP_PARTITION_IN_AXI_SRAM (xrw)     : ORIGIN = 0x24008000, LENGTH = 0x8000
    OS_CONSTS_PARTITION_IN_SRAM4 (xrw)     : ORIGIN = 0x38000000, LENGTH = 0x8000
    OS_VARS_PARTITION_IN_SRAM4 (xrw)     : ORIGIN = 0x38008000, LENGTH = 0x8000
    PROGRAM_DEFAULT_CM7_DATA_PARTITION_IN_DTCM (xrw)     : ORIGIN = 0x20002800, LENGTH = 0x0300
    PROGRAM_DEFAULT_CM7_HEAP_PARTITION_IN_DTCM (xrw)     : ORIGIN = 0x20002b00, LENGTH = 0x0100
    PROGRAM_TIMING_MEASUREMENT_CM7_DATA_PARTITION_IN_DTCM (xrw)     : ORIGIN = 0x20002c00, LENGTH = 0x0300
    PROGRAM_TIMING_MEASUREMENT_CM7_HEAP_PARTITION_IN_DTCM (xrw)     : ORIGIN = 0x20002f00, LENGTH = 0x0100
    PROGRAM_DEFAULT_CM4_DATA_PARTITION_IN_SRAM1 (xrw)     : ORIGIN = 0x10001c00, LENGTH = 0x0300
    PROGRAM_DEFAULT_CM4_HEAP_PARTITION_IN_SRAM1 (xrw)     : ORIGIN = 0x10001f00, LENGTH = 0x0100
    PROGRAM_TIMING_MEASUREMENT_CM4_DATA_PARTITION_IN_SRAM1 (xrw)     : ORIGIN = 0x10002000, LENGTH = 0x0300
    PROGRAM_TIMING_MEASUREMENT_CM4_HEAP_PARTITION_IN_SRAM1 (xrw)     : ORIGIN = 0x10002300, LENGTH = 0x0100
    PROGRAM_LOGGER_DATA_PARTITION_IN_SRAM1 (xrw)     : ORIGIN = 0x10002400, LENGTH = 0x0300
    PROGRAM_LOGGER_HEAP_PARTITION_IN_SRAM1 (xrw)     : ORIGIN = 0x10002700, LENGTH = 0x0100
    PROGRAM_ETHERNET_COM_DATA_PARTITION_IN_DTCM (xrw)     : ORIGIN = 0x20003000, LENGTH = 0x0200
    PROGRAM_ETHERNET_COM_HEAP_PARTITION_IN_DTCM (xrw)     : ORIGIN = 0x20003200, LENGTH = 0x0200
    PROGRAM_CHANNEL_TEST_CM7_DATA_PARTITION_IN_DTCM (xrw)     : ORIGIN = 0x20003400, LENGTH = 0x0200
    PROGRAM_CHANNEL_TEST_CM7_HEAP_PARTITION_IN_DTCM (xrw)     : ORIGIN = 0x20003600, LENGTH = 0x0200
    PROGRAM_CHANNEL_TEST_CM4_DATA_PARTITION_IN_SRAM1 (xrw)     : ORIGIN = 0x10002800, LENGTH = 0x0200
    PROGRAM_CHANNEL_TEST_CM4_HEAP_PARTITION_IN_SRAM1 (xrw)     : ORIGIN = 0x10002a00, LENGTH = 0x0200
    PROGRAM_INTERRUPT_HANDLERS_CM7_DATA_PARTITION_IN_DTCM (xrw)     : ORIGIN = 0x20003800, LENGTH = 0x0200
    PROGRAM_INTERRUPT_HANDLERS_CM7_HEAP_PARTITION_IN_DTCM (xrw)     : ORIGIN = 0x20003a00, LENGTH = 0x0200
    }

SECTIONS
{
    /* The startup code goes first into FLASH */
    .isr_vector :
    {
        . = ALIGN(4);
        KEEP(*(.isr_vector)) /* Startup code */
        . = ALIGN(4);
    } >FLASH_LOCAL

    .lwip_section :
    {
        . = ABSOLUTE(0x30040000);
        *(.RxDecripSection)
        . = ABSOLUTE(0x30040060);
        *(.TxDecripSection)
        . = ABSOLUTE(0x30040200);
        *(.RxArraySection)
    } > LWIP_SRAM3_PATCH

    _flash_program_default_CM7_section_init = LOADADDR(.program_default_CM7_section_init);

    /* Init section */
    .program_default_CM7_section_init :
    {
        . = ALIGN(4);
        _s_program_default_CM7_section_init = .;          /* create a global symbol at section start */
        KEEP(*(.default_CM7_init));
        . = ALIGN(4);
        _e_program_default_CM7_section_init = .;          /* create a global symbol at section end */
    } >PROGRAM_DEFAULT_CM7_DATA_PARTITION_IN_DTCM AT> FLASH_LOCAL

    /* No init section */
    .program_default_CM7_section_noInit :
    {
        . = ALIGN(4);
        _s_program_default_CM7_section_noInit = .;          /* create a global symbol at section start */
        KEEP(*(.default_CM7_noInit));
        . = ALIGN(4);
        _e_program_default_CM7_section_noInit = .;          /* create a global symbol at section end */
    } >PROGRAM_DEFAULT_CM7_DATA_PARTITION_IN_DTCM
    _flash_program_timing_measurement_CM7_section_init = LOADADDR(.program_timing_measurement_CM7_section_init);

    /* Init section */
    .program_timing_measurement_CM7_section_init :
    {
        . = ALIGN(4);
        _s_program_timing_measurement_CM7_section_init = .;          /* create a global symbol at section start */
        KEEP(*(.timing_measurement_CM7_init));
        . = ALIGN(4);
        _e_program_timing_measurement_CM7_section_init = .;          /* create a global symbol at section end */
    } >PROGRAM_TIMING_MEASUREMENT_CM7_DATA_PARTITION_IN_DTCM AT> FLASH_LOCAL

    /* No init section */
    .program_timing_measurement_CM7_section_noInit :
    {
        . = ALIGN(4);
        _s_program_timing_measurement_CM7_section_noInit = .;          /* create a global symbol at section start */
        KEEP(*(.timing_measurement_CM7_noInit));
        . = ALIGN(4);
        _e_program_timing_measurement_CM7_section_noInit = .;          /* create a global symbol at section end */
    } >PROGRAM_TIMING_MEASUREMENT_CM7_DATA_PARTITION_IN_DTCM
    _flash_program_default_CM4_section_init = LOADADDR(.program_default_CM4_section_init);

    /* Init section */
    .program_default_CM4_section_init :
    {
        . = ALIGN(4);
        _s_program_default_CM4_section_init = .;          /* create a global symbol at section start */
        KEEP(*(.default_CM4_init));
        . = ALIGN(4);
        _e_program_default_CM4_section_init = .;          /* create a global symbol at section end */
    } >PROGRAM_DEFAULT_CM4_DATA_PARTITION_IN_SRAM1 AT> FLASH_LOCAL

    /* No init section */
    .program_default_CM4_section_noInit :
    {
        . = ALIGN(4);
        _s_program_default_CM4_section_noInit = .;          /* create a global symbol at section start */
        KEEP(*(.default_CM4_noInit));
        . = ALIGN(4);
        _e_program_default_CM4_section_noInit = .;          /* create a global symbol at section end */
    } >PROGRAM_DEFAULT_CM4_DATA_PARTITION_IN_SRAM1
    _flash_program_timing_measurement_CM4_section_init = LOADADDR(.program_timing_measurement_CM4_section_init);

    /* Init section */
    .program_timing_measurement_CM4_section_init :
    {
        . = ALIGN(4);
        _s_program_timing_measurement_CM4_section_init = .;          /* create a global symbol at section start */
        KEEP(*(.timing_measurement_CM4_init));
        . = ALIGN(4);
        _e_program_timing_measurement_CM4_section_init = .;          /* create a global symbol at section end */
    } >PROGRAM_TIMING_MEASUREMENT_CM4_DATA_PARTITION_IN_SRAM1 AT> FLASH_LOCAL

    /* No init section */
    .program_timing_measurement_CM4_section_noInit :
    {
        . = ALIGN(4);
        _s_program_timing_measurement_CM4_section_noInit = .;          /* create a global symbol at section start */
        KEEP(*(.timing_measurement_CM4_noInit));
        . = ALIGN(4);
        _e_program_timing_measurement_CM4_section_noInit = .;          /* create a global symbol at section end */
    } >PROGRAM_TIMING_MEASUREMENT_CM4_DATA_PARTITION_IN_SRAM1
    _flash_program_logger_section_init = LOADADDR(.program_logger_section_init);

    /* Init section */
    .program_logger_section_init :
    {
        . = ALIGN(4);
        _s_program_logger_section_init = .;          /* create a global symbol at section start */
        KEEP(*(.logger_init));
        . = ALIGN(4);
        _e_program_logger_section_init = .;          /* create a global symbol at section end */
    } >PROGRAM_LOGGER_DATA_PARTITION_IN_SRAM1 AT> FLASH_LOCAL

    /* No init section */
    .program_logger_section_noInit :
    {
        . = ALIGN(4);
        _s_program_logger_section_noInit = .;          /* create a global symbol at section start */
        KEEP(*(.logger_noInit));
        . = ALIGN(4);
        _e_program_logger_section_noInit = .;          /* create a global symbol at section end */
    } >PROGRAM_LOGGER_DATA_PARTITION_IN_SRAM1
    _flash_program_ethernet_com_section_init = LOADADDR(.program_ethernet_com_section_init);

    /* Init section */
    .program_ethernet_com_section_init :
    {
        . = ALIGN(4);
        _s_program_ethernet_com_section_init = .;          /* create a global symbol at section start */
        KEEP(*(.ethernet_com_init));
        . = ALIGN(4);
        _e_program_ethernet_com_section_init = .;          /* create a global symbol at section end */
    } >PROGRAM_ETHERNET_COM_DATA_PARTITION_IN_DTCM AT> FLASH_LOCAL

    /* No init section */
    .program_ethernet_com_section_noInit :
    {
        . = ALIGN(4);
        _s_program_ethernet_com_section_noInit = .;          /* create a global symbol at section start */
        KEEP(*(.ethernet_com_noInit));
        . = ALIGN(4);
        _e_program_ethernet_com_section_noInit = .;          /* create a global symbol at section end */
    } >PROGRAM_ETHERNET_COM_DATA_PARTITION_IN_DTCM
    _flash_program_channel_test_CM7_section_init = LOADADDR(.program_channel_test_CM7_section_init);

    /* Init section */
    .program_channel_test_CM7_section_init :
    {
        . = ALIGN(4);
        _s_program_channel_test_CM7_section_init = .;          /* create a global symbol at section start */
        KEEP(*(.channel_test_CM7_init));
        . = ALIGN(4);
        _e_program_channel_test_CM7_section_init = .;          /* create a global symbol at section end */
    } >PROGRAM_CHANNEL_TEST_CM7_DATA_PARTITION_IN_DTCM AT> FLASH_LOCAL

    /* No init section */
    .program_channel_test_CM7_section_noInit :
    {
        . = ALIGN(4);
        _s_program_channel_test_CM7_section_noInit = .;          /* create a global symbol at section start */
        KEEP(*(.channel_test_CM7_noInit));
        . = ALIGN(4);
        _e_program_channel_test_CM7_section_noInit = .;          /* create a global symbol at section end */
    } >PROGRAM_CHANNEL_TEST_CM7_DATA_PARTITION_IN_DTCM
    _flash_program_channel_test_CM4_section_init = LOADADDR(.program_channel_test_CM4_section_init);

    /* Init section */
    .program_channel_test_CM4_section_init :
    {
        . = ALIGN(4);
        _s_program_channel_test_CM4_section_init = .;          /* create a global symbol at section start */
        KEEP(*(.channel_test_CM4_init));
        . = ALIGN(4);
        _e_program_channel_test_CM4_section_init = .;          /* create a global symbol at section end */
    } >PROGRAM_CHANNEL_TEST_CM4_DATA_PARTITION_IN_SRAM1 AT> FLASH_LOCAL

    /* No init section */
    .program_channel_test_CM4_section_noInit :
    {
        . = ALIGN(4);
        _s_program_channel_test_CM4_section_noInit = .;          /* create a global symbol at section start */
        KEEP(*(.channel_test_CM4_noInit));
        . = ALIGN(4);
        _e_program_channel_test_CM4_section_noInit = .;          /* create a global symbol at section end */
    } >PROGRAM_CHANNEL_TEST_CM4_DATA_PARTITION_IN_SRAM1
    _flash_program_interrupt_handlers_CM7_section_init = LOADADDR(.program_interrupt_handlers_CM7_section_init);

    /* Init section */
    .program_interrupt_handlers_CM7_section_init :
    {
        . = ALIGN(4);
        _s_program_interrupt_handlers_CM7_section_init = .;          /* create a global symbol at section start */
        KEEP(*(.interrupt_handlers_CM7_init));
        . = ALIGN(4);
        _e_program_interrupt_handlers_CM7_section_init = .;          /* create a global symbol at section end */
    } >PROGRAM_INTERRUPT_HANDLERS_CM7_DATA_PARTITION_IN_DTCM AT> FLASH_LOCAL

    /* No init section */
    .program_interrupt_handlers_CM7_section_noInit :
    {
        . = ALIGN(4);
        _s_program_interrupt_handlers_CM7_section_noInit = .;          /* create a global symbol at section start */
        KEEP(*(.interrupt_handlers_CM7_noInit));
        . = ALIGN(4);
        _e_program_interrupt_handlers_CM7_section_noInit = .;          /* create a global symbol at section end */
    } >PROGRAM_INTERRUPT_HANDLERS_CM7_DATA_PARTITION_IN_DTCM
    _flash_os_section_consts_start = LOADADDR(.os_section_consts);

    /* Initialized data sections goes into RAM, load LMA copy after code */
    .os_section_consts :
    {
        . = ALIGN(4);
        _s_os_section_consts = .;          /* create a global symbol at data start */
        KEEP (*(SORT(.os_consts.*)));
        KEEP (*(.os_consts*));
        _e_consts_align_helper = .;        /* create a helper for log2 alignment */
        . = ALIGN((0x2 << (LOG2CEIL (_e_consts_align_helper) - 1)));
        _e_os_section_consts = .;          /* create a global symbol at data end */
    } >OS_CONSTS_PARTITION_IN_SRAM4 AT> FLASH_LOCAL 
    _flash_os_section_vars_start = LOADADDR(.os_section_vars);

    /* Initialized data sections goes into RAM, load LMA copy after code */
    .os_section_vars :
    {
        . = ALIGN(4);
        _s_os_section_vars = .;          /* create a global symbol at data start */
        KEEP (*(SORT(.os_vars.*)));
        KEEP (*(.os_vars*));
        _e_vars_align_helper = .;        /* create a helper for log2 alignment */
        . = ALIGN((0x2 << (LOG2CEIL (_e_vars_align_helper) - 1)));
        _e_os_section_vars = .;          /* create a global symbol at data end */
    } >OS_VARS_PARTITION_IN_SRAM4 AT> FLASH_LOCAL 
    /* The os code goes into FLASH */
    .os_section_funcs :
    {
        . = ALIGN(4);
        _s_os_section_funcs = .;          /* create a global symbol at data start */
        KEEP (*(SORT(.os_funcs.*)));
        KEEP (*(.os_funcs*));
        _e_funcs_align_helper = .;        /* create a helper for log2 alignment */
        . = ALIGN((0x2 << (LOG2CEIL (_e_funcs_align_helper) - 1)));
        _e_os_section_funcs = .;          /* create a global symbol at data end */
    } >FLASH_LOCAL

    /* FLASH_USER_CODE_CM7 */
    .application_section_funcs_CM7 :
    {
        . = ALIGN(4);
        KEEP (*(SORT(.application_funcs_CM7.*)));
        KEEP(*(.application_funcs_CM7));
        . = ALIGN(4);
    } > FLASH_USER_CODE_CM7
    /* FLASH_USER_CODE_CM4 */
    .application_section_funcs_CM4 :
    {
        . = ALIGN(4);
        KEEP (*(SORT(.application_funcs_CM4.*)));
        KEEP(*(.application_funcs_CM4));
        . = ALIGN(4);
    } > FLASH_USER_CODE_CM4
    /* The program code and other data goes into FLASH */
    .text :
    {
        . = ALIGN(4);
        *(.text)           /* .text sections (code) */
        *(.text*)          /* .text* sections (code) */
        *(.glue_7)         /* glue arm to thumb code */
        *(.glue_7t)        /* glue thumb to arm code */
        *(.eh_frame)
        KEEP (*(.init))
        KEEP (*(.fini))
        . = ALIGN(4);
        _etext = .;        /* define a global symbols at end of code */
    } >FLASH_LOCAL

    /* Constant data goes into FLASH */
    .rodata :
    {
        . = ALIGN(4);
        *(.rodata)         /* .rodata sections (constants, strings, etc.) */
        *(.rodata*)        /* .rodata* sections (constants, strings, etc.) */
        . = ALIGN(4);
    } >FLASH_LOCAL

    .ARM.extab   : { *(.ARM.extab* .gnu.linkonce.armextab.*) } >FLASH_LOCAL
    .ARM : {
        __exidx_start = .;
        *(.ARM.exidx*)
        __exidx_end = .;
    } >FLASH_LOCAL

    .preinit_array     :
    {
        PROVIDE_HIDDEN (__preinit_array_start = .);
        KEEP (*(.preinit_array*))
        PROVIDE_HIDDEN (__preinit_array_end = .);
    } >FLASH_LOCAL
    .init_array :
    {
        PROVIDE_HIDDEN (__init_array_start = .);
        KEEP (*(SORT(.init_array.*)))
        KEEP (*(.init_array*))
        PROVIDE_HIDDEN (__init_array_end = .);
    } >FLASH_LOCAL
    .fini_array :
    {
        PROVIDE_HIDDEN (__fini_array_start = .);
        KEEP (*(SORT(.fini_array.*)))
        KEEP (*(.fini_array*))
        PROVIDE_HIDDEN (__fini_array_end = .);
    } >FLASH_LOCAL

    /* used by the startup to initialize data */
    _sidata = LOADADDR(.data);

    /* Initialized data sections goes into RAM, load LMA copy after code */
    .data :
    {
        . = ALIGN(4);
        _s_unprotected_section = .;          /* create a global symbol at data start */
        _sdata = .;        /* create a global symbol at data start */
        *(.data)           /* .data sections */
        *(.data*)          /* .data* sections */
        . = ALIGN(4);
        _edata = .;        /* define a global symbol at data end */
    } >UNMAPPED_DATA_PARTITION_IN_AXI_SRAM AT> FLASH_LOCAL


    /* Uninitialized data section */
    . = ALIGN(4);
    .bss :
    {
        /* This is used by the startup in order to initialize the .bss secion */
        _sbss = .;         /* define a global symbol at bss start */
        __bss_start__ = _sbss;
        *(.bss)
        *(.bss*)
        *(COMMON)
        . = ALIGN(4);
        _ebss = .;         /* define a global symbol at bss end */
        __bss_end__ = _ebss;
        _e_unprotected_align_helper = .;        /* create a helper for log2 alignment */
        . = ALIGN((0x2 << (LOG2CEIL (_e_unprotected_align_helper) - 1)));
        _e_unprotected_section = .;          /* create a global symbol at data start */
    } >UNMAPPED_DATA_PARTITION_IN_AXI_SRAM

    /* Remove information from the standard libraries */
    /DISCARD/ :
    {
        libc.a ( * )
        libm.a ( * )
        libgcc.a ( * )
        *(.program_default_CM4_section_init*)
        *(.program_default_CM4_section_noInit*)
        *(.program_timing_measurement_CM4_section_init*)
        *(.program_timing_measurement_CM4_section_noInit*)
        *(.program_logger_section_init*)
        *(.program_logger_section_noInit*)
        *(.program_channel_test_CM4_section_init*)
        *(.program_channel_test_CM4_section_noInit*)
        *(.application_section_funcs_CM4*)
        }

    .ARM.attributes 0 : { *(.ARM.attributes) }
}